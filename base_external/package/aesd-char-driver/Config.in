## base_external/package/aesd-char-driver/Config.in
```kconfig
config BR2_PACKAGE_AESD_CHAR_DRIVER
	bool "aesd-char-driver"
	help
	  AESD assignment 8 character driver
```

## base_external/package/ldd/Config.in
```kconfig
config BR2_PACKAGE_LDD
        bool "ldd"
        depends on BR2_LINUX_KERNEL
        help
          This includes the ldd package.
```
